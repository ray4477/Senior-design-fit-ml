## custom_nrf_firmware/build/custom_nrf_firmware/Kconfig/Kconfig.shield
```kconfig
osource "C:/Users/raymo/nordic/boards/shields/*/Kconfig.shield"
osource "C:/Users/raymo/Documents/GitHub/Senior-design-fit-ml/custom_nrf_firmware/boards/shields/*/Kconfig.shield"
osource "C:/ncs/v2.9.0/nrf/boards/shields/*/Kconfig.shield"
```

## custom_nrf_firmware/build/custom_nrf_firmware/Kconfig/Kconfig.shield.defconfig
```kconfig
osource "C:/Users/raymo/nordic/boards/shields/*/Kconfig.defconfig"
osource "C:/Users/raymo/Documents/GitHub/Senior-design-fit-ml/custom_nrf_firmware/boards/shields/*/Kconfig.defconfig"
osource "C:/ncs/v2.9.0/nrf/boards/shields/*/Kconfig.defconfig"
```

## custom_nrf_firmware/build/custom_nrf_firmware/Kconfig/boards/Kconfig.defconfig
```kconfig
# Load Zephyr board defconfig descriptions.
osource "C:/Users/raymo/nordic/boards/fitml/nrf52811_wearable/Kconfig.defconfig"
```

## custom_nrf_firmware/build/custom_nrf_firmware/Kconfig/boards/Kconfig.nrf52811_wearable
```kconfig
# Load board Kconfig descriptions.
osource "C:/Users/raymo/nordic/boards/fitml/nrf52811_wearable/Kconfig.nrf52811_wearable"
```

## nrf_firmware/build_3/Kconfig/Kconfig.shield.defconfig
```kconfig
osource "C:/Users/raymo/Documents/GitHub/Senior-design-fit-ml/nrf_firmware/boards/shields/*/Kconfig.defconfig"
osource "C:/ncs/v2.9.0/nrf/boards/shields/*/Kconfig.defconfig"
```

## nrf_firmware/build_custom/Kconfig/Kconfig.shield
```kconfig
osource "C:/Users/raymo/nordic/boards/shields/*/Kconfig.shield"
osource "C:/Users/raymo/Documents/GitHub/Senior-design-fit-ml/nrf_firmware/boards/shields/*/Kconfig.shield"
osource "C:/ncs/v2.9.0/nrf/boards/shields/*/Kconfig.shield"
```

## nrf_firmware/nrf_wearable/Kconfig/boards/Kconfig
```kconfig
# Load Zephyr board Kconfig descriptions.
osource "C:/Users/raymo/nordic/boards/fitml/nrf52811_wearable/Kconfig"
```

## nrf_firmware/nrf_wearable/nrf_firmware/Kconfig/boards/Kconfig.sysbuild
```kconfig
# Load Sysbuild board Kconfig descriptions.
osource "C:/Users/raymo/nordic/boards/fitml/nrf52811_wearable/Kconfig.sysbuild"
```
